## Config.in
```kconfig
source "$BR2_EXTERNAL_DGPPKG_PATH/package/libxmp/Config.in"
source "$BR2_EXTERNAL_DGPPKG_PATH/package/xmp/Config.in"
source "$BR2_EXTERNAL_DGPPKG_PATH/package/mhz/Config.in"
source "$BR2_EXTERNAL_DGPPKG_PATH/package/gt/Config.in"
```

## package/gt/Config.in
```kconfig
config BR2_PACKAGE_GT
	bool "gt"
	depends on BR2_TOOLCHAIN_BUILDROOT_CXX
	select BR2_PACKAGE_LIBUSBGX
	help
	  gadget-tool for configuring USB gadgets
```

## package/xmp/Config.in
```kconfig
config BR2_PACKAGE_XMP
	bool "xmp"
	select BR2_PACKAGE_LIBXMP
	imply BR2_PACKAGE_ALSA_LIB
	help
	  XMP module player
```
